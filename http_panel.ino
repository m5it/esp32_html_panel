/**
 * (24.9.22)
 * Created by t3ch aka B.K. aka grandekos aka w4d4f4k aka etc..
 * For: ESP32, Arduino, similar.?
 * Useful to control GPIO pins trough WiFi + HTTP server and it configurations.
 * -----
 * Recommented editor usage: Geany + Fold all functions so you see better. And because you can use geany for any language and all easier adjust to your eyes. :)
 * Compiling with Arduino IDE..
 * -----
 * G00d luck to all***
 * t3ch
 * */
//
#include <Arduino.h>
#include "WiFi.h"
#include <ArduinoJson.h> // https://arduinojson.org/?utm_source=meta&utm_medium=library.properties
#include <GParser.h>     // https://github.com/GyverLibs/GParser
#include <AceCRC.h>      // https://github.com/bxparks/AceCRC
#include <Regexp.h>      // https://github.com/nickgammon/Regexp
#include <DHT.h>         // https://github.com/m5it/DHT_sensor_library_modified, https://www.mouser.com/datasheet/2/758/DHT11-Technical-Data-Sheet-Translated-Version-1143054.pdf
#include <stdio.h>
#include <time.h>
//
#define MAX_REQ_LENGTH 1024

//--
// startup http panel credentials
//const char* admin_user = "esp32Admin";
//const char* admin_pass = "esp32Pass";
// wifi configs.
const char* ssid = "esp32byk0s";
const char* pwd  = "esp32bypwd";
//
struct Options {
    int LoopDefault      = 25;
    int LoopIdle         = 1000;
    int disp_stats_every = 3; // display stats to Serial every 3s
};
//
Options options;
int loopDelay = options.LoopDefault;
//
IPAddress IP;
// start http server on port 80
WiFiServer server(80);

//
struct Statistics {
    int num_loops       = 0;
    int num_clients     = 0;
    int num_restarts    = 0;
    double last_loop_ts = 0; // last loop timestamp in ms
    double last_disp_ts = 0; // (timestamp in ms) to know when statistics was displayed last time (Used for debug and Serial output)
};
Statistics stats;

//
DynamicJsonDocument json_user_panel(4048);
DynamicJsonDocument tasks(4048);
DynamicJsonDocument actions(1024);
String sson_user_panel = "";
String html_user_panel = "";
boolean html_user_panel_ready = false;
// html_start_panel = upload_file_form.html converted with ghexc.php
char html_start_panel[] = 
"\x3c\x68\x74\x6d\x6c\x3e\xa\x3c\x68\x65\x61\x64\x3e\xa\x9\x3c\x6d\x65\x74\x61\x20\x6e\x61\x6d\x65\x3d\x22\x76\x69\x65\x77"
"\x70\x6f\x72\x74\x22\x20\x63\x6f\x6e\x74\x65\x6e\x74\x3d\x22\x77\x69\x64\x74\x68\x3d\x31\x30\x30\x25\x2c\x20\x69\x6e\x69\x74"
"\x69\x61\x6c\x2d\x73\x63\x61\x6c\x65\x3d\x31\x2c\x20\x6d\x61\x78\x69\x6d\x75\x6d\x2d\x73\x63\x61\x6c\x65\x3d\x31\x2c\x20\x6d"
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"\x69\x73\x29\x3b\x22\x3e\xa\x3c\x2f\x66\x6f\x72\x6d\x3e\xa\xa\x3c\x2f\x62\x6f\x64\x79\x3e\xa\x3c\x2f\x68\x74\x6d\x6c\x3e"
"\xa";



//--
// MISSING C FUNCTIonS START
//---------------------------
void toLower(char *str);
int pmatch(char * checkString, char *pattern);
int cmatch(char checkString[], char *pattern);
char ** split(const char * str, const char * delim);
void substring(const char s[], char sub[], int p, int l);
char* str_replace(const char* s, const char* oldW, const char* newW);
char *strstrip(char *s);
void phex(char *txt, const char* s);
char * c2c(const char *from);
char * crc32b(const char* from);


//--
// Program functions START
//---------------------------
//
void cliHandler( void * client );
void htmlHeader(WiFiClient cli, int code, int length, char type[]);
void htmlDocument(WiFiClient cli, String html);
String getURLPV(char urlargs[], char *name);

//--
// Default Arduino functions START
//---------------------------------
void setup() {
    //
    Serial.begin(115200);
    //
    WiFi.mode(WIFI_AP);
    delay(100);
    WiFi.softAP(ssid, pwd);
    delay(200);
    IP = WiFi.softAPIP();
    //
    delay(100);
    Serial.print("WebServer IP: ");
    Serial.println(IP);
    server.begin();
}

void loop() {
    //
    WiFiClient cli = server.available();
    //
    if( cli ) {
        /*TaskHandle_t cliHandle;
        //
        xTaskCreate(//PinnedToCore(
          cliHandler, // Function to implement the task 
          "cliHandler", // Name of the task 
          10000,  // Stack size in words 
          &cli,//NULL,  // Task input parameter 
          0,  // Priority of the task 
          &cliHandle  // Task handle. 
          ); // Core where the task should run
        //
        vTaskDelay(1);
        */
        
        cliHandler( &cli );
        //
        stats.num_clients++;
    }
    //
    stats.num_loops++;
    //
    // Lets display statististics not every loop.
    if( stats.last_disp_ts==0 || ((stats.last_disp_ts+(options.disp_stats_every*1000))<=(time(0)*1000)) ) {
        char *out = (char*)malloc(1024);
        sprintf(out,"Debug END Loop, num_loops: %i, num_clients: %i, num_restarts: %i, freeheap: %lu, wifi.sleep: %ld",
            stats.num_loops, stats.num_clients, stats.num_restarts, ESP.getFreeHeap(), WiFi.getSleep());
        Serial.println(out);
        stats.last_disp_ts = time(0)*1000;
        free(out);
    }
    //
    stats.last_loop_ts = time(0)*1000;
    delay(loopDelay);
}



//
void cliHandler( void * client ) {
    WiFiClient cli = *((WiFiClient*)client);
    int length = 0, errorCode = 0;
    boolean headDone = false, error=false;
    char cmdline[1024]={0};
    char cmd1[56]={0};            // GET | POST | HEAD | OPTIONS
    char cmd2[1024-56-56]={0};    // (max size:912) GET request Ex.: /up=true Or /upc=true Or /reset Or just /
    char cmd3[56]={0};            // HTTP version
    char type[128]={0};
    //
    String body;
    int partAt=0, partOf=0;
    //
    boolean returnSuccess = true;
    boolean returnJson    = false;
    float returnVal       = NULL;
    //String taskTitle      = "";
    //
    DHT dht; // (30.9.22) support for DHT sensors! Required modified DHT library at: 
    
    //
    //cli.setTimeout(15);
    //
    while( cli.connected() ) {
        // Connect
        if( cli.available() ) {
            //
            String line    = cli.readStringUntil('\r');
            
            //Serial.println("line: ");
            //Serial.println(line);
            //Serial.println(line.length());
            
            //
            char fixline[line.length()+1] = {0};
            line.toCharArray(fixline,line.length()+1);
            //
            char lowline[line.length()+1] = {0};
            line.toCharArray(lowline,line.length()+1);
            
            // Fix the line
            if( line.length()>=3 && cmatch(fixline,"^\xa.*")==1 ) {
                substring(line.c_str(),fixline,2,line.length());
                substring(line.c_str(),lowline,2,line.length());
            }
            toLower(lowline);
            // Header done
            if( !headDone && line=="\xa" ) {
                headDone = true;
                // Content-Length Not Set
                if( length==0 ) {
                    break;
                }
                // Content-Length is Set, continue retriving body
            }
            // Header receiving
            else if(!headDone) {
                // parse header command / option
                if( cmatch(fixline,"^GET.*")==1 ||
                    cmatch(fixline,"^POST.*")==1 ) {
                    //
                    char *tmpcmd = str_replace(fixline,"  "," "); // fix double space for one
                    char **cmd   = split( tmpcmd, " " );
                    //
                    for(int i=0; cmd[i]!=NULL; i++) {
                        switch(i) {
                            case 0:
                                strcpy(cmd1,cmd[0]);
                                break;
                            case 1:
                                if( strlen(cmd[1])>MAX_REQ_LENGTH ) {
                                    errorCode  = 414;
                                    error      = true;
                                    break;
                                }
                                strcpy(cmd2,cmd[1]);
                                break;
                            case 2:
                                strcpy(cmd3,cmd[2]);
                                break;
                            default:
                                break;
                        }
                        //
                        if( error ) break;
                    }
                    strcpy(cmdline,tmpcmd);
                    for(int i=0; cmd[i]!=NULL; i++) free(cmd[i]);
                    free(cmd);
                    free(tmpcmd);
                    //
                    if( error ) break;
                }
                // parse Content-Type
                else if( cmatch(lowline,"^content.type.*")==1 ) {
                    char ** tmp = split(line.c_str(),": ");
                    strcpy(type,tmp[1]);
                    for(int i=0; tmp[i]!=NULL; i++) free(tmp[i]);
                    free(tmp);
                }
                // parse Content-Length
                else if( cmatch(lowline,"^content.length.*")==1 ) {
                    char ** tmp = split(line.c_str(),": ");
                    length      = strtol(tmp[1], NULL, 0);
                    for(int i=0; tmp[i]!=NULL; i++) free(tmp[i]);
                    free(tmp);
                }
            }
            // Body done
            else if( headDone && line=="\xa" ) {
                break;
            }
            // Body receiving
            else {
                // If request is not allowed request then send 405 Not Allowed!
                if( pmatch(cmd2,"^\/up\=true.*")==0 &&
                    pmatch(cmd2,"^\/upc\=true.*")==0 ) {
                    Serial.println("DEBUG BODY ADD NOT ALLOWED.");
                    error     = true;
                    errorCode = 405; // method not allowed
                    break;
                }
                
                // If received content is bigger or equal Content-Length we have all content, End.
                if( length>0 && body.length() >= length ) {
                    Serial.println("DEBUG BODY ADD/ENDING...!");
                    break;
                }
                
                // Receive body
                body += line+"\n";
                //strcat(body,line.c_str());
            }
        }
        else {
            break;
        }
    }
    
    //--
    // Parse and handle commands
    //-------------------
    if( !error ) {
        // Uploading new command panel
        if( !html_user_panel_ready && body.length()>0 && pmatch(cmd2,"^\/up\=true.*")==1 ) {
            Serial.println("DEBUG parsing new panel..");
            // parse number of parts of file and it position
            partAt = strtol(getURLPV(cmd2,"partAt").c_str(),NULL,0);
            partOf = strtol(getURLPV(cmd2,"partOf").c_str(),NULL,0);
            // remove characters that are bad characters when you dont want them.. :D
            body.trim();
            // concat body parts and generate whole file (html user panel)
            char bodyArray[body.length()]={0};
            body.toCharArray(bodyArray,body.length());
            if(partAt<(partOf-1)) {
                html_user_panel += GP_urldecode(body);
            }
            else {
                html_user_panel += GP_urldecode(body);
                html_user_panel_ready = true;
            }
            returnJson    = true;
            returnSuccess = true;
        }
        // Uploading new configurations for panel
        // Execute setups
        else if( html_user_panel.length()==0 && body.length()>0 && pmatch(cmd2,"^\/upc\=true")==1 ) {
            Serial.println("DEBUG parsing new panel configuration..");
            //
            sson_user_panel = GP_urldecode( body );
            deserializeJson(json_user_panel, sson_user_panel);
            tasks = json_user_panel["tasks"];
            
            // Loop trough json configured setups, functions that should be executed only once. Ex.: pinMode(),...
            DynamicJsonDocument setups(1024);
            setups = json_user_panel["setups"];
            for(int i=0; i<setups.size(); i++) {
                String setupAction = setups[i]["action"]; // mode,DHT...
                int gpio = setups[i]["gpio"];
                int val  = setups[i]["value"];
                //
                if( setupAction=="mode" ) {
                    pinMode(setups[i]["gpio"],(setups[i]["value"]=="OUTPUT"?OUTPUT:INPUT));
                }
                //
                else if( setupAction=="DHT" ) {
                    dht.setPinNType( setups[i]["gpio"], setups[i]["value"] );
                    dht.begin();
                }
            }
            setups.clear();
        }
        // Reset uploaded panel
        else if( pmatch(cmd2, "^\/reset+$")==1 ) {
            Serial.println("DEBUG reseting to start_panel...");
            /*html_user_panel = "";
            html_user_panel_ready = false;
            partAt=0;
            partOf=0;
            tasks.clear();
            actions.clear();
            json_user_panel.clear();*/
            ESP.restart();
        }
    }
    
    //--
    // Handle JSON Configured commands/requests
    //---------------------------------
    // Loop trough json configured tasks and check if request match. Functions that can be executed here ex.: analogWrite, analogRead, 
    //   digitalWrite, digitalRead etc..
    // Execute tasks
    for(int i=0; i<tasks.size(); i++) {
        String taskTitle   = tasks[i]["title"];
        String taskRequest = tasks[i]["request"];
        actions            = tasks[i]["actions"];
        
        // Request match for action!
        char tmpRequest[taskRequest.length()+1] = {0};
        taskRequest.toCharArray(tmpRequest,taskRequest.length()+1);
        //
        if( cmatch(cmd2,tmpRequest)==1 ) {
            // Loop trough request actions and exec them..
            for(int j=0; j<actions.size(); j++) {
                Serial.println("Entering action...");
                // Ex. action: {"gpio":27,"value":0,"type":"DW"}
                // value 0 = LOW, 1=HIGH
                // todo DW = digitalWrite, DR = digitalRead, AW = analogWrite, AR = analogRead
                int gpio         = actions[j]["gpio"];
                int value        = actions[j]["value"];
                String paramName = actions[j]["paramName"]; // If set then value is retrived from urls parameters
                String type      = actions[j]["type"]; 
                
                // Retrive value from cmd2 (url) if paramName not empty
                if( !paramName.isEmpty() && paramName!="null" && paramName!=NULL ) {
                    char *cparamName = c2c(paramName.c_str());
                    value = strtol(getURLPV(cmd2,cparamName).c_str(),NULL,0);
                    free(cparamName);
                }
                
                //--
                // Digital Write
                if( type=="DW" ) {
                    Serial.println("DEBUG FIRING DW!");
                    digitalWrite( gpio, value );
                    returnJson = true;
                }
                // Digital Read
                else if( type=="DR" ) {
                    Serial.println("DEBUG FIRING DR!");
                    returnVal = digitalRead( gpio );
                    returnJson = true;
                    Serial.println( returnVal );
                }
                // Analog Write
                else if( type=="AW" ) {
                    Serial.println("DEBUG FIRING AW!");
                    analogWrite( gpio, value );
                    returnJson = true;
                }
                // Analog Read
                else if( type=="AR" ) {
                    Serial.println("DEBUG FIRING AR!");
                    returnVal = analogRead( gpio );
                    returnJson = true;
                    Serial.println( returnVal );
                }
                // DHT Temperature
                else if( type=="DHTT" ) {
                    Serial.println("DEBUG FIRING DHTT!");
                    returnVal = dht.readTemperature();
                    returnJson = true;
                    Serial.println( returnVal );
                }
                // DHT Humidity
                else if( type=="DHTH" ) {
                    Serial.println("DEBUG FIRING DHTH!");
                    returnVal = dht.readHumidity();
                    returnJson = true;
                    Serial.println( returnVal );
                }
                // Unknown command
                else {
                    Serial.println("DEBUG NOT CORRECT TYPE...");
                    returnSuccess = false;
                }
            }
            break;
        }
    }
  
    //--
    // Handle response
    //-----------------
    //
    if( error ) {
        String tmpJson;
        StaticJsonDocument<200> doc;
        doc["error"] = true;
        serializeJson(doc, tmpJson);
        htmlHeader(cli,errorCode,tmpJson.length(),type);
        htmlDocument(cli,tmpJson);
        doc.clear();
    }
    //
    else if( returnJson ) {
        String tmpJson;
        StaticJsonDocument<200> doc;
        doc["success"] = returnSuccess;
        doc["data"] = returnVal;
        serializeJson(doc, tmpJson);
        htmlHeader(cli,200,tmpJson.length(),type);
        htmlDocument(cli,tmpJson);
        doc.clear();
    }
    //
    else {
        htmlHeader(cli,200,(html_user_panel_ready?html_user_panel.length():strlen(html_start_panel)),type);
        htmlDocument(cli,(html_user_panel_ready?html_user_panel:html_start_panel));
    }
    
    //
    cli.stop();
    cli.flush();
    //xTaskDestroy(NULL);
}
//
void htmlHeader(WiFiClient cli, int code, int length, char type[]) {
    char * tmp = (char*)malloc(56);
    memset(tmp,'\0',56);
    sprintf(tmp,"HTTP/1.1 %i OK", code);
    cli.println(tmp);
    //
    if( strlen(type)>0) {
        cli.println("Content-type: application/json");
    }
    else {
        cli.println("Content-type: text/html");
    }
    //
    if( length>0 ) {
        memset(tmp,'\0',56);
        sprintf(tmp,"Content-Length: %i", length);
        cli.println(tmp);
    }
    //
    //cli.println("Cache-Control: no-cache");
    cli.println("Cache-Control: no-store, must-revalidate");
    cli.println("Pragma: no-cache");
    cli.println("Expires: 0");
    cli.println("Connection: close");
    cli.println("");
    free(tmp);
}
//
void htmlDocument(WiFiClient cli, String html) {
    cli.println( html );
}
//
String getURLPV(char urlargs[], char *name) {
    if( cmatch(urlargs,"\?")==0 ) return "";
    //
    char **args1 = split(urlargs,"?");
    char **args2 = split(args1[1],"&");
    String ret   = "";
    //
    for(int i=0; args2[i]!=NULL; i++) {
        char **args3 = split(args2[i],"=");
        if( cmatch(args3[0],name)==1 ) {
            ret = args3[1];
        }
        //
        free(args3[0]);
        free(args3[1]);
        free(args3);
        free(args2[i]);
        //
        if(ret!="") break;
    }
    free(args2);
    free(args1);
    return ret;
}



//--
// Missing and Useful C Functions START
//--------------------------------------
// (1.10.22) by t3ch
void toLower(char *str) {
    char *a=str;
    char *b=str;
    while(*a) {
        *b = tolower(*a);
        a++;
        b++;
    }
    b=0;
    a=0;
}
/**
 * Match string against the extended regular expression in
 * pattern, treating errors as no match.
 *
 * return 1 for match, 0 for no match
 */
//
int pmatch(char * checkString, char *pattern) {
    //
    MatchState ms;
    ms.Target( checkString );
    char result = ms.Match( pattern );
    if (result>0) {
        return(1);
    }
    return(0);
}
//
int cmatch(char checkString[], char *pattern) {
    //
    MatchState ms;
    ms.Target( checkString );
    char result = ms.Match( pattern );
    if (result>0) {
        return(1);
    }
    return(0);
}
/**
 * function split() taken from: 
 * https://stackoverflow.com/questions/54261257/splitting-a-string-and-returning-an-array-of-strings
 * Fixed by t3ch for arduino.
 * */
char ** split(const char * str, const char * delim) {
  /* count words */
  char * s = strdup(str);
  
  if (strtok(s, delim) == 0)
  /* no word */
  return NULL;
  
  int nw = 1;
  
  while (strtok(NULL, delim) != 0)
  nw += 1;
  
  strcpy(s, str); /* restore initial string modified by strtok */
  
  /* split */
  //char ** v = malloc((nw + 1) * sizeof(char *));
  char ** v = (char**)malloc((nw + 1) * sizeof(char *));
  int i;
  
  v[0] = strdup(strtok(s, delim));
  //
  for (i = 1; i != nw; ++i) {
    v[i] = strdup( strtok(NULL, delim) );
  }
  v[i] = NULL; /* end mark */
  free(s);
  return v;
}

/**
 * Reference by: https://www.geeksforgeeks.org/c-program-replace-word-text-another-given-word/
 * */
char* str_replace(const char* s, const char* oldW, const char* newW) {
    char* result;
    int i, cnt = 0;
    int newWlen = strlen(newW);
    int oldWlen = strlen(oldW);
 
    // Counting the number of times old word
    // occur in the string
    for (i = 0; s[i] != '\0'; i++) {
        if (strstr(&s[i], oldW) == &s[i]) {
            cnt++;
 
            // Jumping to index after the old word.
            i += oldWlen - 1;
        }
    }
 
    // Making new string of enough length
    result = (char*)malloc(i + cnt * (newWlen - oldWlen) + 1);
 
    i = 0;
    while (*s) {
        // compare the substring with the result
        if (strstr(s, oldW) == s) {
            strcpy(&result[i], newW);
            i += newWlen;
            s += oldWlen;
        }
        else
            result[i++] = *s++;
    }
 
    result[i] = '\0';
    return result;
}

/***/
char *strstrip(char *s) {
        size_t size;
        char *end;

        size = strlen(s);

        if (!size)
                return s;

        end = s + size - 1;
        while (end >= s && isspace(*end))
                end--;
        *(end + 1) = '\0';

        while (*s && isspace(*s))
                s++;

        return s;
}

/**
// substring(...)
// C substring function definition
// p=1...X
// l=strlen(s)
// Ex: substring(tmp1, tmp2, 2, strlen(tmp1));
*/
void substring(const char s[], char sub[], int p, int l) {
   int c = 0;
   
   while (c < l) {
      sub[c] = s[p+c-1];
      c++;
   }
   sub[c] = '\0';
}

/*void swap(String **a, String **b) {
  String * t = *a;
  *a = *b;
  *b = t;
}*/

//
void phex(char *txt, const char* s) {
  char* tmp = (char*)malloc(128);
  memset(tmp,'\0',128);
  for(int i=0; i<strlen(s); i++) {
    int x = (int)s[i];
    if(i==0) sprintf(tmp,"%s: %s%x",txt,tmp,x);
    else     sprintf(tmp,"%s%x",tmp,x);
  }
  Serial.println( tmp );
  free(tmp);
}

//
char * c2c(const char *from) {
    char  *ret = (char*)malloc(strlen(from)+1);
    strcpy(ret, from);
    return ret;
}

//
char * crc32b(const char* from) {
    static const size_t LENGTH = sizeof(from) - 1;
    using namespace ace_crc::crc32_byte;//crc32_nibblem;//crc16ccitt_nibble;
    //
    crc_t crc = crc_init();
    crc = crc_update(crc, from, LENGTH);
    crc = crc_finalize(crc);
    char * ret = (char*)malloc(11);
    sprintf(ret,"%X",(unsigned long)crc);
    return ret;
}
